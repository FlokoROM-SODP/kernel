## arch/arm64/configs/lineage_additional_defconfig
```kconfig
CONFIG_KSM=y
CONFIG_TCP_CONG_ADVANCED=y
CONFIG_TCP_CONG_WESTWOOD=y
CONFIG_TCP_CONG_HTCP=y
CONFIG_TCP_CONG_HSTCP=y
CONFIG_HZ=300
CONFIG_HZ_300=y
```
